#include "Config.h"
#include "EC11.h"
#include "Buzzer.h"

/******************************************************************************/
// 变量初始化
/******************************************************************************/
bit PinA_LastState; //EC11 A脚上一次的电平
bit PinB_LastState; //EC11 B脚上一次的电平

s8 EC11_Value;     //EC11正反转表示值
u8 EC11_Rate;      //EC11快慢转倍率
u8 EC11_Count;     //EC11有效正/反转计数
u8 TimeCounter;    //EC11用来复位快转倍率的时间计数器

u8 EC11_State;    //EC11用来表示当前状态的变量

extern u8 LCD1602_Show_State;

extern u8 Menu_Index;
extern s8 Menu_Edit_Value;
extern u8 Menu_Flag;
/******************************************************************************/
// EC11初始化函数
// 函数名称：EC11_Init
// 输入参数：无
// 输出参数：无 
// 函数功能：初始化EC11
/******************************************************************************/
void EC11_Init(){
	EC11_Key = 1;
	EC11_A = 1;
	EC11_B = 1;
	
	PinA_LastState = 1;
	PinB_LastState = 1;
	
	EC11_Value = 0;  
	EC11_Rate = 1;   
	EC11_Count = 0;
	TimeCounter = 0;
	
	EC11_State = 0;

	
	/*外部中断0初始化*/
//	IT0 = 1;    //设置外部中断0触发方式(1:下降沿 0:低电平)
//  EX0 = 1;    //开启外部中断0开关
	
}

/*
void EC11_Key_Down() //interrupt INTERRUPT_EXTERNAL_0
{
	EC11_State = 3;
	Buzzer_Open();
}
*/

 



/******************************************************************************/
// EC11扫描函数
// 函数名称：EC11_Scan
// 输入参数：无
// 输出参数：无 
// 函数功能：EC11函数处理
/******************************************************************************/
void EC11_Scan()
{
/******************************************************************************/
// EC11按键处理部分（以此注释向下）
/******************************************************************************/
		static u16 key_press_time = 0; //按键按下的时间
//	  static bit Show_State = 0;
    if(EC11_Key == 0)  //当按键处于持续按下的状态
		{
		  /*计量按键时间，并避免数据溢出*/
			if(++key_press_time <=0 ) {--key_press_time;}
			
			/*当按键持续按下的时间达到2S时处理的事件*/
			if(key_press_time==400){
				
				/*在不同显示状态下做出的处理*/
				//显示点阵时钟时做出的处理
				if(LCD1602_Show_State==0){  
					Menu_Index = 0;
					LCD1602_Show_State = 2;  
					
				//显示日期时间时做出的处理
				}else if(LCD1602_Show_State==1){
					Menu_Index = 0;
					LCD1602_Show_State = 2;
					
				//显示菜单界面时做出的处理
				}else if(LCD1602_Show_State==2){
					LCD1602_Show_State = 0;
	
				}
				EC11_State = 0; //清零EC11状态
				Buzzer_Open();
			}
		
    }else {  //否则处理当按键释放后
			
			/*当按下时间大于25ms并且小于2S时处理事件*/
			if(5<=key_press_time && key_press_time < 400){
				
				/*在不同显示状态下做出的处理*/
				//显示点阵时钟时做出的处理
				if(LCD1602_Show_State==0){
					LCD1602_Show_State = 1;    //切换为日期时间显示状态
					EC11_State = 0;  //清除EC11按键状态
	
				//显示日期时间时做出的处理
				}else if(LCD1602_Show_State==1){
					LCD1602_Show_State = 0;    //切换为点阵时钟显示状态
					EC11_State = 0;  //清除EC11按键状态
					
				//显示菜单界面时做出的处理
				}else if(LCD1602_Show_State==2){

					EC11_State = 3;  //EC11为按键按下的状态
	
				}
				
				
				Buzzer_Open();
			}
			key_press_time=0; //按键释放且处理完毕将按下时间清零
    }
/******************************************************************************/
// EC11按键处理部分（以此注释向上）
/******************************************************************************/		

/******************************************************************************/
// EC11旋转处理部分（以此注释向下）
/******************************************************************************/
		
		/*如果时间计数器达到(5ms*100)=0.5s*/
		if(++TimeCounter == 100){
			TimeCounter = 0; //复位时间计数器
			EC11_Count = 0; //清除EC11有效(正/反)转计数
			EC11_Rate = 1;  //复位EC11快慢转倍率为1倍
		}
	
		/*EC11快慢转*/
		/*如果EC11有效(正/反)转计数达到5次*/
	  if(EC11_Count > 5){  
		  EC11_Rate = 10;  //设置EC11快慢转倍率为10倍
	  }else{
			EC11_Rate = 1; //复位EC11快慢转倍率为1倍
		}
	
	/*当"A脚现在是低电平" 
	 与 "A脚前一次是高电平" 
	 与 "B脚现在是高电平"   时成立*/
	if(!EC11_A && PinA_LastState && EC11_B) {
    EC11_Value = (-1)*EC11_Rate;    //逆时针旋转	
		EC11_State = 1;  //EC11状态为1（逆时针旋转状态）
		EC11_Count++;   //EC11有效计数+1
		Buzzer_Open();
		
	/*当"B脚现在是低电平" 
	 与 "B脚前一次是高电平" 
	 与 "A脚现在是高电平"   时成立*/
	}else if(!EC11_B && PinB_LastState && EC11_A) {
		EC11_Value = 1*EC11_Rate;     //顺时针旋转
		EC11_State = 2; //EC11状态为2（顺时针旋转状态）
		EC11_Count++;   //EC11有效计数+1
		Buzzer_Open();
		
	}else{  
		EC11_Value = 0;
	}
	
	/*每次循环记录AB相状态*/
	PinA_LastState = EC11_A;
	PinB_LastState = EC11_B;
	
	if(Menu_Flag==4){
		Menu_Edit_Value += EC11_Value;
	}else{
		Menu_Edit_Value = 0;
	}
	
/******************************************************************************/
// EC11旋转处理部分（以此注释向上）
/******************************************************************************/	
}
       
